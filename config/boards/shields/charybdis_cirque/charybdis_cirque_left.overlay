#include "charybdis_cirque.dtsi" // Notice that the main dtsi files are included in the overlay.



&kscan0 {
    diode-direction = "col2row";
    col-gpios
        = <&pro_micro 11 (GPIO_ACTIVE_HIGH)> // COL0 
        , <&pro_micro 10 (GPIO_ACTIVE_HIGH)> // COL1 
        , <&pro_micro 9 (GPIO_ACTIVE_HIGH)> // COL2 
        , <&pro_micro 2 (GPIO_ACTIVE_HIGH)> // COL3 
	    , <&pro_micro 15 (GPIO_ACTIVE_HIGH)> // COL1 
        , <&pro_micro 3 (GPIO_ACTIVE_HIGH)> // COL2 
        ;
};
